## main/Kconfig.projbuild
```kconfig
# SPDX-FileCopyrightText: 2026 PaulsKlaue
# SPDX-License-Identifier: MIT
#
# Kconfig.projbuild — BP10 DSP Controller
#

menu "BP10 DSP Controller"

    config BP10_USB_VID
        hex "MVSilicon USB VID"
        default 0x8888
        help
            USB Vendor ID des MVSilicon-Geräts.

    config BP10_USB_PID
        hex "MVSilicon USB PID"
        default 0x171E
        help
            USB Product ID des MVSilicon-Geräts.

    config BP10_HID_REPORT_SIZE
        int "HID Report Size (Bytes)"
        default 256
        help
            Größe des HID SET_REPORT in Bytes.

    config BP10_USB_DEVICE_WAIT_MS
        int "USB Device Wait Time (ms)"
        default 3000
        help
            Wartezeit nach Power-On, bis der DSP gebootet ist.

    config BP10_DIAGNOSTIC_NS_BOOT_TEST
        bool "Noise-Suppressor-Schalttest beim USB-Connect"
        default n
        help
            Expliziter Diagnosemodus. Schaltet den Noise Suppressor beim
            Verbinden AUS und wieder EIN. Im normalen Betrieb deaktiviert.

    config BP10_WIFI_SETUP_TIMEOUT_S
        int "WiFi Setup Window (seconds)"
        default 180
        help
            Zeitfenster für WiFi-Setup nach Power-On (0 = unbegrenzt).

    config BP10_MDNS_DEFAULT_HOSTNAME
        string "Default mDNS Hostname prefix"
        default "bp10"
        help
            Präfix für den mDNS-Hostnamen. Die MAC-Kurzform wird angehängt.

    config BP10_HTTP_PORT
        int "HTTP Server Port"
        default 80
        help
            Port des integrierten Webservers.

    config BP10_NVS_NAMESPACE
        string "NVS Namespace"
        default "bp10"
        help
            NVS-Namespace für alle Einstellungen.

    config BP10_MAX_PROFILES
        int "Maximum DSP Profile Count"
        default 8
        range 1 32
        help
            Maximale Anzahl speicherbarer DSP-Profile.

endmenu
```

## sdkconfig.defaults
```kconfig
# SPDX-FileCopyrightText: 2026 CobbyCode
# SPDX-License-Identifier: GPL-3.0-or-later
#
# sdkconfig.defaults — BP10 DSP Controller
# Target: ESP32-S3FH4R2 (4 MB Quad flash, 2 MB Quad PSRAM)

# Chip target
CONFIG_IDF_TARGET="esp32s3"

# Flash
CONFIG_ESPTOOLPY_FLASHSIZE_4MB=y
CONFIG_ESPTOOLPY_FLASHMODE_QIO=y
CONFIG_ESPTOOLPY_FLASHFREQ_80M=y

# In-package 2 MB Quad SPI PSRAM
CONFIG_SPIRAM=y
CONFIG_SPIRAM_MODE_QUAD=y
CONFIG_SPIRAM_SPEED_80M=y
CONFIG_SPIRAM_TYPE_AUTO=y
CONFIG_SPIRAM_ALLOW_STACK_EXTERNAL_MEMORY=y

# Custom 4 MB OTA partition table
CONFIG_PARTITION_TABLE_CUSTOM=y
CONFIG_PARTITION_TABLE_CUSTOM_FILENAME="partitions.csv"
CONFIG_PARTITION_TABLE_FILENAME="partitions.csv"

# USB host
CONFIG_USB_HOST_CONTROL_TRANSFER_MAX_SIZE=256
CONFIG_USB_HOST_HW_BUFFER_BIAS_BALANCED=y

# FreeRTOS
CONFIG_FREERTOS_HZ=1000

# Wi-Fi
CONFIG_ESP_WIFI_STATIC_RX_BUFFER_NUM=10
CONFIG_ESP_WIFI_DYNAMIC_RX_BUFFER_NUM=32
CONFIG_ESP_WIFI_TX_BUFFER_TYPE=1
CONFIG_ESP_WIFI_DYNAMIC_TX_BUFFER_NUM=32

# mDNS
CONFIG_MDNS_MAX_SERVICES=1
CONFIG_MDNS_MAX_INTERFACES=4

# HTTP server
CONFIG_HTTPD_MAX_REQ_HDR_LEN=512
CONFIG_HTTPD_MAX_URI_LEN=512
CONFIG_HTTPD_WS_SUPPORT=y

# OTA and rollback
CONFIG_ESP_HTTPS_OTA_ALLOW_HTTP=y
CONFIG_ESP_HTTPS_OTA_DECRYPT_CB=y
CONFIG_BOOTLOADER_APP_ROLLBACK_ENABLE=y
CONFIG_APP_ROLLBACK_ENABLE=y

# Logging and console
CONFIG_LOG_DEFAULT_LEVEL_INFO=y
CONFIG_LOG_DEFAULT_LEVEL=3
CONFIG_LOG_TIMESTAMP_SOURCE_RTOS=y
CONFIG_ESP_CONSOLE_UART_DEFAULT=y
CONFIG_ESP_CONSOLE_UART_BAUDRATE=115200

# Size optimization
CONFIG_COMPILER_OPTIMIZATION_SIZE=y

# HTTP client / TLS support
CONFIG_ESP_HTTP_CLIENT_ENABLE_HTTPS=y
CONFIG_ESP_TLS_INSECURE=y
CONFIG_ESP_TLS_SKIP_SERVER_CERT_VERIFY=y
```
